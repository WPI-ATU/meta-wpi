## conf/layer.conf
```bitbake
# We have a conf and classes directory, add to BBPATH
BBPATH .= ":${LAYERDIR}"

# We have recipes-* directories, add to BBFILES
BBFILES += "${LAYERDIR}/recipes-*/*/*.bb \
            ${LAYERDIR}/recipes-*/*/*.bbappend"

BBFILE_COLLECTIONS += "meta-wpi"
BBFILE_PATTERN_meta-wpi = "^${LAYERDIR}/"
BBFILE_PRIORITY_meta-wpi = "6"

LAYERDEPENDS_meta-wpi = "core"
LAYERSERIES_COMPAT_meta-wpi = "kirkstone langdale"
```

## conf/machine/opgyro.conf
```bitbake
MACHINEOVERRIDES =. "opgyro:"
require conf/machine/imx93-11x11-lpddr4x-evk.conf

MACHINE="opgyro"

KERNEL_DEVICETREE = " \
	wpi/op-gyro.dtb \
"

UBOOT_CONFIG_BASENAME = "op_gyro"
```

## conf/machine/opkillerdesktop.conf
```bitbake
MACHINEOVERRIDES =. "opkillerdesktop:"

require conf/machine/opkiller.conf
require conf/machine/include/ubuntubasics.inc

# MACHINE should set after require other conf, or it would be override by other conf
MACHINE="opkillerdesktop"
```
